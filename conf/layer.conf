## conf/layer.conf
```bitbake
# Copyright (C) 2020 Joshua Watt <JPEWhacker@gmail.com>
# Released under the MIT license (see COPYING.MIT for the terms)

# We have a conf and classes directory, add to BBPATH
BBPATH .= ":${LAYERDIR}"

# We have recipes-* directories, add to BBFILES
BBFILES += "${LAYERDIR}/recipes-*/*/*.bb ${LAYERDIR}/recipes-*/*/*.bbappend"

BBFILE_COLLECTIONS += "doom"
BBFILE_PATTERN_doom = "^${LAYERDIR}/"
BBFILE_PRIORITY_doom = "10"

# This should only be incremented on significant changes that will
# cause compatibility issues with other layers
LAYERVERSION_doom = "1"
LAYERSERIES_COMPAT_doom = "mickledore"
LAYERDEPENDS_doom = "core openembedded-layer"

# Prevent the native versions of the zdoom recipes from figuring into the task
# signatures for the target version. Then native versions are still
# dependencies that have to exist, but they are only providing native tools so
# the specific task signatures shouldn't be included.
SIGGEN_EXCLUDE_SAFE_RECIPE_DEPS += "\
    lzdoom->lzdoom-native \
    gzdoom->gzdoom-native \
    "

# gzdoom is preferred, but it doesn't build for 32-bit platforms
PREFERRED_PROVIDER_virtual/zdoom ?= "${@bb.utils.contains_any("TRANSLATED_TARGET_ARCH", "arm x86", "lzdoom", "gzdoom", d)}"
```
